## CMakeLists.txt
```
# SPDX-License-Identifier: Apache-2.0

# Specify minimum CMake version required
cmake_minimum_required(VERSION 3.20.0)

# Set the target board to Raspberry Pi Pico
set(BOARD rpi_pico)
# Specify the Device Tree overlay file that contains custom board configurations
set(DTC_OVERLAY_FILE "board/app.overlay")

# Find and include the Zephyr package which provides build system integration
# REQUIRED ensures CMake will error if Zephyr isn't found
# HINTS tells CMake where to look for Zephyr using the ZEPHYR_BASE environment variable
find_package(Zephyr REQUIRED HINTS $ENV{ZEPHYR_BASE})

# Define the project name
project(ZEPHYR_APP_1)

# Add the main application source file
target_sources(app PRIVATE src/main.c)

# Add the button driver source files
target_sources(app PRIVATE
    drivers/button/src/button_driver.c
)

# Add the driver include directory
target_include_directories(app PRIVATE drivers/button/include)
```

## Kconfig
```
source "Kconfig.zephyr"

rsource "drivers/button/Kconfig" 
```

## prj.conf
```kconfig
CONFIG_GPIO=y
CONFIG_LOG=y
CONFIG_LOG_DEFAULT_LEVEL=3
CONFIG_LOG_BACKEND_UART=y
CONFIG_SERIAL=y
CONFIG_UART_CONSOLE=y
CONFIG_BUTTON_DRIVER=y
```

## dts/bindings/button-driver.yaml
```yaml
description: Button driver for Raspberry Pi Pico

compatible: "button-driver"

include: base.yaml

properties:
  gpios:
    type: phandle-array
    required: true
    description: GPIO pin for the button

  label:
    type: string
    required: true
    description: Human readable string describing the device 
```

## src/main.c
```c
/**
 * @file main.c
 * @brief Sample application using the button driver
 */

#include <zephyr/kernel.h>
#include <zephyr/device.h>
#include <zephyr/drivers/gpio.h>
#include <zephyr/logging/log.h>
#include "button_driver.h"

LOG_MODULE_REGISTER(main, CONFIG_LOG_DEFAULT_LEVEL);

#define SLEEP_TIME_MS   100

void main(void)
{
	const struct device *button = DEVICE_DT_GET(DT_ALIAS(button0));
	bool last_state = false;
	bool current_state;

	if (!device_is_ready(button)) {
		LOG_ERR("Button device not ready");
		return;
	}

	LOG_INF("Button application started");

	while (1) {
		current_state = button_driver_is_pressed(button);
		
		if (current_state != last_state) {
			LOG_INF("Button state changed: %s", 
				   current_state ? "pressed" : "released");
			last_state = current_state;
		}

		k_msleep(SLEEP_TIME_MS);
	}
}
```
