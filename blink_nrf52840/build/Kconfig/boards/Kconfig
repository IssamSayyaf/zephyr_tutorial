## blink_nrf52840/build/Kconfig/boards/Kconfig
```kconfig
# Load Zephyr board Kconfig descriptions.
osource "/home/issam/zephyrproject/zephyr/boards/nordic/nrf52840dk/Kconfig"
```

## button/build/Kconfig/boards/Kconfig.nrf52840dk
```kconfig
# Load board Kconfig descriptions.
osource "/home/issam/zephyrproject/zephyr/boards/nordic/nrf52840dk/Kconfig.nrf52840dk"
```

## button/build/Kconfig/boards/Kconfig.sysbuild
```kconfig
# Load Sysbuild board Kconfig descriptions.
osource "/home/issam/zephyrproject/zephyr/boards/nordic/nrf52840dk/Kconfig.sysbuild"
```

## modules/custom_drivers/Kconfig
```kconfig
# SPDX-License-Identifier: Apache-2.0
# Custom Drivers Module Kconfig

menu "Custom Drivers"

rsource "drivers/uart_advanced/Kconfig"
rsource "drivers/spi_advanced/Kconfig"
rsource "drivers/mpu6050/Kconfig"
rsource "drivers/ublox_neo_m8n/Kconfig"
rsource "drivers/ultrasonic/Kconfig"

endmenu
```

## modules/custom_drivers/drivers/mpu6050/Kconfig
```kconfig
# SPDX-License-Identifier: Apache-2.0
# MPU6050 Custom Sensor Driver Kconfig

menuconfig MPU6050_CUSTOM
    bool "MPU6050 IMU Sensor Driver"
    depends on I2C
    help
      Enable driver for InvenSense MPU6050 6-axis IMU sensor.
      Provides accelerometer and gyroscope readings.

if MPU6050_CUSTOM

config MPU6050_CUSTOM_INIT_PRIORITY
    int "Driver initialization priority"
    default 90
    help
      Device driver initialization priority.

choice MPU6050_ACCEL_FS
    prompt "Accelerometer full-scale range"
    default MPU6050_ACCEL_FS_2G

config MPU6050_ACCEL_FS_2G
    bool "+/- 2g"

config MPU6050_ACCEL_FS_4G
    bool "+/- 4g"

config MPU6050_ACCEL_FS_8G
    bool "+/- 8g"

config MPU6050_ACCEL_FS_16G
    bool "+/- 16g"

endchoice

choice MPU6050_GYRO_FS
    prompt "Gyroscope full-scale range"
    default MPU6050_GYRO_FS_250DPS

config MPU6050_GYRO_FS_250DPS
    bool "+/- 250 dps"

config MPU6050_GYRO_FS_500DPS
    bool "+/- 500 dps"

config MPU6050_GYRO_FS_1000DPS
    bool "+/- 1000 dps"

config MPU6050_GYRO_FS_2000DPS
    bool "+/- 2000 dps"

endchoice

config MPU6050_SAMPLE_RATE_DIV
    int "Sample rate divider"
    default 0
    range 0 255
    help
      Sample rate = Gyroscope Output Rate / (1 + SMPLRT_DIV)
      Gyroscope Output Rate = 8kHz (DLPF disabled) or 1kHz (DLPF enabled)

config MPU6050_DLPF_CFG
    int "Digital Low Pass Filter configuration"
    default 6
    range 0 7
    help
      DLPF configuration value.
      0: Accel 260Hz, Gyro 256Hz
      1: Accel 184Hz, Gyro 188Hz
      2: Accel 94Hz, Gyro 98Hz
      3: Accel 44Hz, Gyro 42Hz
      4: Accel 21Hz, Gyro 20Hz
      5: Accel 10Hz, Gyro 10Hz
      6: Accel 5Hz, Gyro 5Hz
      7: Reserved

config MPU6050_TRIGGER
    bool "Enable trigger mode"
    depends on GPIO
    help
      Enable interrupt-based data ready trigger.

choice MPU6050_TRIGGER_MODE
    prompt "Trigger mode"
    depends on MPU6050_TRIGGER
    default MPU6050_TRIGGER_GLOBAL_THREAD

config MPU6050_TRIGGER_NONE
    bool "No trigger"

config MPU6050_TRIGGER_GLOBAL_THREAD
    bool "Use global thread"

config MPU6050_TRIGGER_OWN_THREAD
    bool "Use own thread"

endchoice

config MPU6050_THREAD_PRIORITY
    int "Trigger thread priority"
    depends on MPU6050_TRIGGER_OWN_THREAD
    default 10

config MPU6050_THREAD_STACK_SIZE
    int "Trigger thread stack size"
    depends on MPU6050_TRIGGER_OWN_THREAD
    default 1024

config MPU6050_SHELL
    bool "Enable shell commands"
    depends on SHELL
    default y
    help
      Enable shell commands for MPU6050 testing.

module = MPU6050_CUSTOM
module-str = mpu6050
source "subsys/logging/Kconfig.template.log_config"

endif # MPU6050_CUSTOM
```

## modules/custom_drivers/drivers/mpu6050/dts/bindings/invensense,mpu6050-custom.yaml
```yaml
# SPDX-License-Identifier: Apache-2.0
# Device Tree binding for MPU6050 Custom Driver

description: |
  InvenSense MPU6050 6-axis IMU sensor.
  Provides 3-axis accelerometer and 3-axis gyroscope readings.

compatible: "invensense,mpu6050-custom"

include: [sensor-device.yaml, i2c-device.yaml]

properties:
  reg:
    required: true
    description: |
      I2C address. Default is 0x68 (AD0 low) or 0x69 (AD0 high).

  int-gpios:
    type: phandle-array
    required: false
    description: |
      GPIO connected to the MPU6050 INT pin for data ready interrupt.

  accel-fs:
    type: int
    required: false
    default: 0
    enum: [0, 1, 2, 3]
    description: |
      Accelerometer full-scale range:
      0 = +/- 2g (default)
      1 = +/- 4g
      2 = +/- 8g
      3 = +/- 16g

  gyro-fs:
    type: int
    required: false
    default: 0
    enum: [0, 1, 2, 3]
    description: |
      Gyroscope full-scale range:
      0 = +/- 250 dps (default)
      1 = +/- 500 dps
      2 = +/- 1000 dps
      3 = +/- 2000 dps

  sample-rate-div:
    type: int
    required: false
    default: 0
    description: |
      Sample rate divider (0-255).
      Sample rate = Gyro Output Rate / (1 + sample-rate-div)
      Gyro Output Rate = 8kHz when DLPF disabled, 1kHz when enabled.

  dlpf-cfg:
    type: int
    required: false
    default: 6
    enum: [0, 1, 2, 3, 4, 5, 6]
    description: |
      Digital Low Pass Filter configuration:
      0 = Accel 260Hz, Gyro 256Hz, Fs = 8kHz
      1 = Accel 184Hz, Gyro 188Hz, Fs = 1kHz
      2 = Accel 94Hz, Gyro 98Hz, Fs = 1kHz
      3 = Accel 44Hz, Gyro 42Hz, Fs = 1kHz
      4 = Accel 21Hz, Gyro 20Hz, Fs = 1kHz
      5 = Accel 10Hz, Gyro 10Hz, Fs = 1kHz
      6 = Accel 5Hz, Gyro 5Hz, Fs = 1kHz (default)
```

## modules/custom_drivers/drivers/spi_advanced/Kconfig
```kconfig
# SPDX-License-Identifier: Apache-2.0
# SPI Advanced Driver Kconfig

menuconfig SPI_ADVANCED
    bool "SPI Advanced Driver"
    depends on SPI
    help
      Enable the advanced SPI driver with full capability support
      including all SPI modes, DMA transfers, interrupts, and
      multi-device chip select management.

if SPI_ADVANCED

config SPI_ADVANCED_INIT_PRIORITY
    int "Driver initialization priority"
    default 60
    help
      Device driver initialization priority.

config SPI_ADVANCED_MAX_FREQUENCY
    int "Maximum SPI frequency (Hz)"
    default 10000000
    help
      Maximum SPI clock frequency supported.

config SPI_ADVANCED_BUFFER_SIZE
    int "Internal buffer size"
    default 256
    range 64 4096
    help
      Size of internal buffer for DMA and async operations.

config SPI_ADVANCED_DMA
    bool "Enable DMA support"
    depends on DMA
    default n
    help
      Enable DMA-based transfers for improved performance.

config SPI_ADVANCED_DMA_THRESHOLD
    int "DMA threshold (bytes)"
    depends on SPI_ADVANCED_DMA
    default 32
    help
      Minimum transfer size to use DMA. Smaller transfers
      will use interrupt or polling mode.

config SPI_ADVANCED_ASYNC
    bool "Enable async API"
    default y
    help
      Enable asynchronous (non-blocking) transfer API.

config SPI_ADVANCED_STATS
    bool "Enable statistics"
    default y
    help
      Track transfer statistics (bytes, errors, timing).

config SPI_ADVANCED_SHELL
    bool "Enable shell commands"
    depends on SHELL
    default y
    help
      Enable shell commands for SPI driver testing.

choice SPI_ADVANCED_DEFAULT_MODE
    prompt "Default SPI mode"
    default SPI_ADVANCED_MODE_0

config SPI_ADVANCED_MODE_0
    bool "Mode 0 (CPOL=0, CPHA=0)"

config SPI_ADVANCED_MODE_1
    bool "Mode 1 (CPOL=0, CPHA=1)"

config SPI_ADVANCED_MODE_2
    bool "Mode 2 (CPOL=1, CPHA=0)"

config SPI_ADVANCED_MODE_3
    bool "Mode 3 (CPOL=1, CPHA=1)"

endchoice

module = SPI_ADVANCED
module-str = spi_advanced
source "subsys/logging/Kconfig.template.log_config"

endif # SPI_ADVANCED
```

## modules/custom_drivers/drivers/spi_advanced/dts/bindings/custom,spi-advanced.yaml
```yaml
# SPDX-License-Identifier: Apache-2.0
# Device Tree binding for SPI Advanced Driver

description: |
  Advanced SPI driver wrapper providing extended functionality
  including multi-device management, DMA support, async operations,
  and comprehensive statistics.

compatible: "custom,spi-advanced"

include: base.yaml

properties:
  spi-device:
    type: phandle
    required: true
    description: |
      Reference to the underlying SPI controller device.

  max-frequency:
    type: int
    required: false
    default: 10000000
    description: |
      Maximum SPI clock frequency in Hz.

  dma-enabled:
    type: boolean
    required: false
    description: |
      Enable DMA for large transfers.

  dma-threshold:
    type: int
    required: false
    default: 32
    description: |
      Minimum transfer size (bytes) to use DMA.
```

## modules/custom_drivers/drivers/uart_advanced/Kconfig
```kconfig
# SPDX-License-Identifier: Apache-2.0
# UART Advanced Driver Kconfig

menuconfig UART_ADVANCED
    bool "UART Advanced Driver"
    depends on SERIAL
    help
      Enable the advanced UART driver with full capability support
      including polling, interrupt, async/DMA, and flow control modes.

if UART_ADVANCED

config UART_ADVANCED_INIT_PRIORITY
    int "Driver initialization priority"
    default 55
    help
      Device driver initialization priority.

config UART_ADVANCED_RX_BUFFER_SIZE
    int "RX buffer size"
    default 256
    range 64 4096
    help
      Size of the receive ring buffer in bytes.

config UART_ADVANCED_TX_BUFFER_SIZE
    int "TX buffer size"
    default 256
    range 64 4096
    help
      Size of the transmit ring buffer in bytes.

config UART_ADVANCED_ASYNC
    bool "Enable async (DMA) mode"
    depends on DMA
    default n
    help
      Enable DMA-based asynchronous transfer support.

config UART_ADVANCED_ASYNC_RX_BUFFER_SIZE
    int "Async RX buffer size"
    depends on UART_ADVANCED_ASYNC
    default 512
    help
      Size of each async receive buffer.

config UART_ADVANCED_ASYNC_RX_BUFFER_COUNT
    int "Number of async RX buffers"
    depends on UART_ADVANCED_ASYNC
    default 2
    range 2 8
    help
      Number of receive buffers for double/multi-buffering.

config UART_ADVANCED_FLOW_CONTROL
    bool "Enable hardware flow control support"
    default n
    help
      Enable RTS/CTS hardware flow control.

config UART_ADVANCED_SHELL
    bool "Enable shell commands"
    depends on SHELL
    default y
    help
      Enable shell commands for UART driver testing and debugging.

module = UART_ADVANCED
module-str = uart_advanced
source "subsys/logging/Kconfig.template.log_config"

endif # UART_ADVANCED
```

## modules/custom_drivers/drivers/uart_advanced/dts/bindings/custom,uart-advanced.yaml
```yaml
# SPDX-License-Identifier: Apache-2.0
# Device Tree binding for UART Advanced Driver

description: |
  Advanced UART driver wrapper providing extended functionality
  including ring buffer management, multiple operating modes,
  and statistics tracking.

compatible: "custom,uart-advanced"

include: base.yaml

properties:
  uart-device:
    type: phandle
    required: true
    description: |
      Reference to the underlying UART device that this driver
      will use for communication.

  current-speed:
    type: int
    required: false
    default: 115200
    description: |
      Default baud rate for the UART. Common values are:
      9600, 19200, 38400, 57600, 115200, 230400, 460800, 921600

  hw-flow-control:
    type: boolean
    required: false
    description: |
      Enable hardware flow control (RTS/CTS).

  rx-buffer-size:
    type: int
    required: false
    default: 256
    description: |
      Size of the RX ring buffer in bytes.

  tx-buffer-size:
    type: int
    required: false
    default: 256
    description: |
      Size of the TX ring buffer in bytes.
```

## modules/custom_drivers/drivers/ublox_neo_m8n/Kconfig
```kconfig
# SPDX-License-Identifier: Apache-2.0
# uBlox NEO-M8N GPS Driver Kconfig

menuconfig UBLOX_NEO_M8N
    bool "uBlox NEO-M8N GPS Driver"
    depends on SERIAL
    help
      Enable driver for uBlox NEO-M8N GPS/GNSS module.
      Parses NMEA sentences for position, velocity, and time.

if UBLOX_NEO_M8N

config UBLOX_NEO_M8N_INIT_PRIORITY
    int "Driver initialization priority"
    default 90
    help
      Device driver initialization priority.

config UBLOX_NEO_M8N_RX_BUFFER_SIZE
    int "NMEA receive buffer size"
    default 256
    range 128 1024
    help
      Size of the NMEA sentence receive buffer.

config UBLOX_NEO_M8N_DEFAULT_BAUDRATE
    int "Default UART baud rate"
    default 9600
    help
      Default baud rate for GPS module communication.
      NEO-M8N default is 9600.

config UBLOX_NEO_M8N_PARSE_GGA
    bool "Parse GGA sentences"
    default y
    help
      Parse GPGGA/GNGGA sentences for position and fix quality.

config UBLOX_NEO_M8N_PARSE_RMC
    bool "Parse RMC sentences"
    default y
    help
      Parse GPRMC/GNRMC sentences for position, speed, and course.

config UBLOX_NEO_M8N_PARSE_GSA
    bool "Parse GSA sentences"
    default y
    help
      Parse GPGSA/GNGSA sentences for DOP and satellite info.

config UBLOX_NEO_M8N_PARSE_GSV
    bool "Parse GSV sentences"
    default n
    help
      Parse GPGSV/GNGSV sentences for satellite details.

config UBLOX_NEO_M8N_PARSE_VTG
    bool "Parse VTG sentences"
    default y
    help
      Parse GPVTG/GNVTG sentences for ground speed.

config UBLOX_NEO_M8N_UBX_PROTOCOL
    bool "Enable UBX protocol support"
    default n
    help
      Enable uBlox proprietary UBX protocol for configuration
      and additional data.

config UBLOX_NEO_M8N_THREAD_STACK_SIZE
    int "Processing thread stack size"
    default 1024
    help
      Stack size for the NMEA parsing thread.

config UBLOX_NEO_M8N_THREAD_PRIORITY
    int "Processing thread priority"
    default 10
    help
      Priority of the NMEA parsing thread.

config UBLOX_NEO_M8N_SHELL
    bool "Enable shell commands"
    depends on SHELL
    default y
    help
      Enable shell commands for GPS testing.

module = UBLOX_NEO_M8N
module-str = ublox_neo_m8n
source "subsys/logging/Kconfig.template.log_config"

endif # UBLOX_NEO_M8N
```

## modules/custom_drivers/drivers/ublox_neo_m8n/dts/bindings/u-blox,neo-m8n.yaml
```yaml
# SPDX-License-Identifier: Apache-2.0
# Device Tree binding for uBlox NEO-M8N GPS

description: |
  uBlox NEO-M8N GPS/GNSS receiver module.
  Provides position, velocity, and time via NMEA protocol.

compatible: "u-blox,neo-m8n"

include: uart-device.yaml

properties:
  current-speed:
    type: int
    required: false
    default: 9600
    description: |
      UART baud rate. NEO-M8N defaults to 9600.
      Can be configured to 4800, 9600, 19200, 38400, 57600, 115200.

  pps-gpios:
    type: phandle-array
    required: false
    description: |
      GPIO connected to the PPS (Pulse Per Second) output.

  reset-gpios:
    type: phandle-array
    required: false
    description: |
      GPIO connected to the reset pin.

  extint-gpios:
    type: phandle-array
    required: false
    description: |
      GPIO connected to the EXTINT pin for external interrupt.

  enable-sbas:
    type: boolean
    required: false
    description: |
      Enable SBAS (Satellite-Based Augmentation System) for improved accuracy.

  enable-glonass:
    type: boolean
    required: false
    description: |
      Enable GLONASS constellation (in addition to GPS).

  enable-galileo:
    type: boolean
    required: false
    description: |
      Enable Galileo constellation.

  dynamic-model:
    type: string
    required: false
    default: "portable"
    enum:
      - "portable"
      - "stationary"
      - "pedestrian"
      - "automotive"
      - "sea"
      - "airborne-1g"
      - "airborne-2g"
      - "airborne-4g"
    description: |
      Navigation dynamic model. Affects position filtering.
```
