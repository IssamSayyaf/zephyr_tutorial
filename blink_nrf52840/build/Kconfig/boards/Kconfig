## modules/custom_drivers/drivers/ultrasonic/Kconfig
```kconfig
# SPDX-License-Identifier: Apache-2.0
# Ultrasonic Distance Sensor Driver Kconfig

menuconfig ULTRASONIC
    bool "Ultrasonic Distance Sensor Driver"
    depends on GPIO
    help
      Enable driver for HC-SR04 style ultrasonic distance sensors.
      Uses GPIO for trigger and echo pins.

if ULTRASONIC

config ULTRASONIC_INIT_PRIORITY
    int "Driver initialization priority"
    default 90
    help
      Device driver initialization priority.

config ULTRASONIC_TRIGGER_PULSE_US
    int "Trigger pulse width (microseconds)"
    default 10
    range 5 20
    help
      Duration of the trigger pulse in microseconds.
      HC-SR04 requires minimum 10us.

config ULTRASONIC_ECHO_TIMEOUT_MS
    int "Echo timeout (milliseconds)"
    default 30
    range 10 100
    help
      Maximum time to wait for echo response.
      30ms corresponds to ~5m range at speed of sound.

config ULTRASONIC_SOUND_SPEED_CM_US
    int "Speed of sound (cm/us * 1000)"
    default 343
    help
      Speed of sound in centimeters per microsecond, multiplied by 1000.
      At 20C, speed is 343 m/s = 0.0343 cm/us = 34.3 (x1000).
      Default 343 = 0.0343 cm/us.

config ULTRASONIC_TEMP_COMPENSATION
    bool "Enable temperature compensation"
    default n
    help
      Adjust speed of sound based on temperature.
      Requires providing temperature during measurement.

config ULTRASONIC_MEDIAN_FILTER
    bool "Enable median filtering"
    default y
    help
      Take multiple readings and return median value
      to reduce noise.

config ULTRASONIC_MEDIAN_SAMPLES
    int "Number of samples for median filter"
    depends on ULTRASONIC_MEDIAN_FILTER
    default 5
    range 3 11
    help
      Number of samples for median filtering.
      Must be odd number.

config ULTRASONIC_MIN_INTERVAL_MS
    int "Minimum interval between measurements (ms)"
    default 60
    help
      Minimum time between measurements to avoid
      interference from previous echo.

config ULTRASONIC_SHELL
    bool "Enable shell commands"
    depends on SHELL
    default y
    help
      Enable shell commands for ultrasonic sensor testing.

module = ULTRASONIC
module-str = ultrasonic
source "subsys/logging/Kconfig.template.log_config"

endif # ULTRASONIC
```

## modules/custom_drivers/drivers/ultrasonic/dts/bindings/custom,ultrasonic.yaml
```yaml
# SPDX-License-Identifier: Apache-2.0
# Device Tree binding for Ultrasonic Distance Sensor

description: |
  HC-SR04 style ultrasonic distance sensor.
  Uses GPIO for trigger and echo pins.

compatible: "custom,ultrasonic"

include: base.yaml

properties:
  trigger-gpios:
    type: phandle-array
    required: true
    description: |
      GPIO pin connected to the TRIG pin of the sensor.
      Configured as output.

  echo-gpios:
    type: phandle-array
    required: true
    description: |
      GPIO pin connected to the ECHO pin of the sensor.
      Configured as input.

  max-range-cm:
    type: int
    required: false
    default: 400
    description: |
      Maximum detection range in centimeters.
      HC-SR04 typical maximum is 400 cm.

  min-range-cm:
    type: int
    required: false
    default: 2
    description: |
      Minimum detection range in centimeters.
      HC-SR04 typical minimum is 2 cm.
```

## threads/build/Kconfig/boards/Kconfig.defconfig
```kconfig
# Load Zephyr board defconfig descriptions.
osource "/home/issam/zephyrproject/zephyr/boards/nordic/nrf52840dk/Kconfig.defconfig"
```

## zephyr_app_1/build/Kconfig/arch/Kconfig
```kconfig
# Load Zephyr Arch Kconfig descriptions.
osource "/home/issam/zephyrproject/zephyr/arch/x86/Kconfig"
osource "/home/issam/zephyrproject/zephyr/arch/xtensa/Kconfig"
osource "/home/issam/zephyrproject/zephyr/arch/sparc/Kconfig"
osource "/home/issam/zephyrproject/zephyr/arch/riscv/Kconfig"
osource "/home/issam/zephyrproject/zephyr/arch/posix/Kconfig"
osource "/home/issam/zephyrproject/zephyr/arch/nios2/Kconfig"
osource "/home/issam/zephyrproject/zephyr/arch/mips/Kconfig"
osource "/home/issam/zephyrproject/zephyr/arch/arm64/Kconfig"
osource "/home/issam/zephyrproject/zephyr/arch/arm/Kconfig"
osource "/home/issam/zephyrproject/zephyr/arch/arc/Kconfig"
```

## zephyr_app_1/build/Kconfig/boards/Kconfig
```kconfig
# Load Zephyr board Kconfig descriptions.
osource "/home/issam/zephyrproject/zephyr/boards/raspberrypi/rpi_pico/Kconfig"
```

## zephyr_app_1/build/Kconfig/boards/Kconfig.defconfig
```kconfig
# Load Zephyr board defconfig descriptions.
osource "/home/issam/zephyrproject/zephyr/boards/raspberrypi/rpi_pico/Kconfig.defconfig"
```

## zephyr_app_1/build/Kconfig/boards/Kconfig.rpi_pico
```kconfig
# Load board Kconfig descriptions.
osource "/home/issam/zephyrproject/zephyr/boards/raspberrypi/rpi_pico/Kconfig.rpi_pico"
```

## zephyr_app_1/build/Kconfig/boards/Kconfig.sysbuild
```kconfig
# Load Sysbuild board Kconfig descriptions.
osource "/home/issam/zephyrproject/zephyr/boards/raspberrypi/rpi_pico/Kconfig.sysbuild"
```

## zephyr_app_1/drivers/button/Kconfig
```kconfig
config BUTTON_DRIVER
	bool "Button Driver"
	depends on GPIO
	help
	  Enable button driver support.

if BUTTON_DRIVER

module = BUTTON_DRIVER
module-str = button driver
source "subsys/logging/Kconfig.template.log_config"

config BUTTON_DRIVER_INIT_PRIORITY
	int "Button driver initialization priority"
	default 75
	help
	  Device driver initialization priority.
	  Device is connected to GPIO pins, it has to
	  be initialized after GPIO driver and after
	  the GPIO pin is configured.

endif # BUTTON_DRIVER 
```

## zephyr_app_1/drivers/button/dts/bindings/button_driver.yaml
```yaml
description: Button driver for Raspberry Pi Pico

compatible: "button-driver"

include: [base.yaml, gpio.yaml]

properties:
  gpios:
    required: true
    description: GPIO pin for the button 
```
